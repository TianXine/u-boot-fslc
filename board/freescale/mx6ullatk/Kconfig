## board/freescale/mx6ullatk/Kconfig
```kconfig
if TARGET_MX6ULL_ATK

config SYS_BOARD
	default "mx6ullatk"

config SYS_VENDOR
	default "freescale"

config SYS_CONFIG_NAME
	default "mx6ullatk"

endif
```
