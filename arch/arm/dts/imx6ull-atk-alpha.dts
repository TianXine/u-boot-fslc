// SPDX-License-Identifier: (GPL-2.0 OR MIT)
//
// Copyright (C) 2016 Freescale Semiconductor, Inc.

/dts-v1/;

#include "imx6ull.dtsi"
#include "imx6ul-14x14-evk.dtsi"

/ {
	model = "Alientek Alpha|Mini Board";
	compatible = "fsl,imx6ull-atk-alpha", "fsl,imx6ull";
};

&clks {
	assigned-clocks = <&clks IMX6UL_CLK_PLL3_PFD2>;
	assigned-clock-rates = <320000000>;
};

&usdhc2{
	/*keep-power-in-suspend;*/
	/* drivers/mmc/fsl_esdhc_imx.c fsl_esdhc_ids */
	/* compatible="fsl,imx6ul-usdhc"; */
	bus-width=<8>;
	non_removable;
	status="okay";
};

